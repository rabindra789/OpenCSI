## firmware/components/wifi/Kconfig.projbuild
```kconfig
menu "WiFi Configuration"

    config ESP_WIFI_SSID
        string "WiFi SSID"
        default "myssid"
        help
            SSID of the WiFi network the ESP32 will connect to.

    config ESP_WIFI_PASSWORD
        string "WiFi Password"
        default "mypassword"
        help
            Password for the WiFi network.

endmenu
```

## firmware/m1_csi_observe/main/Kconfig.projbuild
```kconfig
menu "WiFi Configuration"

    config ESP_WIFI_SSID
        string "WiFi SSID"
        default "myssid"
        help
            SSID of the WiFi network the ESP32 will connect to.
            Set this to your own network name via 'idf.py menuconfig'.

    config ESP_WIFI_PASSWORD
        string "WiFi Password"
        default "mypassword"
        help
            Password for the WiFi network.
            Set this to your own password via 'idf.py menuconfig'.

endmenu
```

## firmware/m1_csi_observe/sdkconfig.defaults
```kconfig
# OpenCSI M1 — CSI Observer
# Placeholder WiFi credentials — replace via 'idf.py menuconfig'
# sdkconfig (the actual generated config) is gitignored.
CONFIG_ESP_WIFI_SSID="changeme"
CONFIG_ESP_WIFI_PASSWORD="changeme"
```

## firmware/m2_exp_001/main/Kconfig.projbuild
```kconfig
menu "Experiment Configuration"

    config EXP_SCENARIO_LABEL
        string "Scenario label"
        default "idle"
        help
            Label for this scenario run (e.g. idle, ping-router, ping-esp32, download, video).

    config EXP_DURATION_SECONDS
        int "Experiment duration (seconds)"
        default 60
        range 10 3600
        help
            How long to accumulate CSI stats before printing final summary.

endmenu
```

## firmware/m2_exp_001/sdkconfig.defaults
```kconfig
CONFIG_ESP_WIFI_SSID="Rabindra"
CONFIG_ESP_WIFI_PASSWORD="Home1234@"
CONFIG_ESP_WIFI_CSI_ENABLED=y
CONFIG_EXP_SCENARIO_LABEL="idle"
CONFIG_EXP_DURATION_SECONDS=60
```

## firmware/m3_exp_002/main/Kconfig.projbuild
```kconfig
menu "Experiment Configuration"

    config EXP_SCENARIO_LABEL
        string "Scenario label"
        default "idle"
        help
            Label for this capture run. Used in metadata output.
            Example: idle-5min, idle-5min-repeat

    config EXP_DURATION_SECONDS
        int "Capture duration (seconds)"
        default 300
        range 10 3600
        help
            How long the experiment runs before auto-completing.

endmenu
```

## firmware/m4_exp_003/main/Kconfig.projbuild
```kconfig
menu "Experiment Configuration"

    config EXP_DURATION_SECONDS
        int "Capture duration (seconds)"
        default 60
        range 10 3600
        help
            How long the experiment runs after first CSI callback.

endmenu
```

## firmware/m5_exp_004/main/Kconfig.projbuild
```kconfig
menu "Experiment Configuration"

    config EXP_SCENARIO_LABEL
        string "Scenario label"
        default "idle"
        help
            Label for this capture run.

    config EXP_DURATION_SECONDS
        int "Capture duration (seconds)"
        default 60
        range 10 3600
        help
            How long the experiment runs after first CSI callback.

    config EXP_ENABLE_TCP_SERVER
        bool "Enable TCP server for TCP download scenario"
        default n
        help
            Enable a TCP server on port 8888 that accepts one connection
            and echoes data. Used for the TCP download traffic scenario.

endmenu
```
